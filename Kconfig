## Kconfig
```kconfig
# SPDX-License-Identifier: GPL-2.0-only
# Helper to resolve issues with configs that have SPI enabled but I2C
# modular, meaning we can't build the codec driver in with I2C support.
# We use an ordered list of conditional defaults to pick the appropriate
# setting - SPI can't be modular so that case doesn't need to be covered.

menu "CODEC drivers"

config SND_SOC_SMA1307
	tristate "Iron Device SMA1307 Audio Amplifier"
	depends on I2C

endmenu
```
